## meta-my-layer/conf/bblayers.conf
```bitbake
# POKY_BBLAYERS_CONF_VERSION is increased each time build/conf/bblayers.conf
# changes incompatibly
POKY_BBLAYERS_CONF_VERSION = "2"

BBPATH = "${TOPDIR}"
BBFILES ?= ""

BBLAYERS ?= " \
  /home/akash/my_build/poky/meta \
  /home/akash/my_build/poky/meta-poky \
  /home/akash/my_build/poky/meta-yocto-bsp \
  "
```
